## meta-demos/conf/distro/homprj-k.conf
```bitbake
# meta-demo distro layer configuration
# include and overwrite default poky distro
include conf/distro/poky.conf

DISTRO = "homprj-k"
DISTRO_NAME = "Home Project for raspberrypi devices for distributed apps"
DISTRO_VERSION = "1.0"
DISTRO_CODENAME = "wastemytime"
SDK_VENDOR = "-homprojks"
SDK_VERSION = "${DISTRO_VERSION}"
MAINTAINER = "armhzjz@pm.me"

TARGET_VENDOR = "-hzjz"


DISTRO_FEATURES:append = " wifi x11 seccomp virtualization k8s"
DISTRO_FEATURES:append = " systemd"
DISTRO_FEATURES:remove = "wayland"

DISTRO_FEATURES_BACKFILL_CONSIDERED += "sysvinit"
VIRTUAL-RUNTIME_init_manager = "systemd"
VIRTUAL-RUNTIME_initscripts = "systemd-compat-units"

PACKAGE_CLASSES ?= "package_ipk"
```

## meta-demos/conf/distro/ml-hzjz.conf
```bitbake
# meta-demo distro layer configuration
# include and overwrite default poky distro
include conf/distro/poky.conf

DISTRO = "ml-hzjz"
DISTRO_NAME = "ML demonstration distro (My own demonstration distro)"
DISTRO_VERSION = "1.0"
DISTRO_CODENAME = "Tequila"
SDK_VENDOR = "-mldemodistrosdk"
SDK_VERSION = "${DISTRO_VERSION}"
MAINTAINER = "armhzjz@pm.me"

TARGET_VENDOR = "-hzjz"


DISTRO_FEATURES_append = " wifi x11"
DISTRO_FEATURES_remove = "wayland"

DISTRO_FEATURES_append = " systemd"
DISTRO_FEATURES_BACKFILL_CONSIDERED += "sysvinit"
VIRTUAL-RUNTIME_init_manager = "systemd"
VIRTUAL-RUNTIME_initscripts = "systemd-compat-units"

PACKAGE_CLASSES ?= "package_ipk"
```

## meta-demos/conf/layer.conf
```bitbake
# We have a conf and classes directory, add to BBPATH
BBPATH .= ":${LAYERDIR}"

# We have recipes-* directories, add to BBFILES
BBFILES += "${LAYERDIR}/recipes-*/*/*.bb \
            ${LAYERDIR}/recipes-*/*/*.bbappend"

BBFILE_COLLECTIONS += "meta-demos"
BBFILE_PATTERN_meta-demos = "^${LAYERDIR}/"
BBFILE_PRIORITY_meta-demos = "6"

LAYERDEPENDS_meta-demos = "core"
LAYERSERIES_COMPAT_meta-demos = "gatesgarth"
```
